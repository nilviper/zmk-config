## boards/shields/argb/Kconfig.defconfig
```kconfig
if SHIELD_ARGB

config ZMK_KEYBOARD_NAME
    default "argb"

endif # SHIELD_ARGB
```

## boards/shields/eddie/Kconfig.defconfig
```kconfig
if SHIELD_EDDIE

config ZMK_KEYBOARD_NAME
    default "eddie"

endif # SHIELD_EDDIE
```

## boards/shields/eddie2/Kconfig.defconfig
```kconfig
if SHIELD_EDDIE2

config ZMK_KEYBOARD_NAME
    default "eddie2"

endif # SHIELD_EDDIE2
```

## boards/shields/nano/Kconfig.defconfig
```kconfig
if SHIELD_NANO_LEFT

config ZMK_KEYBOARD_NAME
    default "nano"

config ZMK_SPLIT_ROLE_CENTRAL
    default y

endif # SHIELD_NANO_LEFT

if SHIELD_NANO_LEFT || SHIELD_NANO_RIGHT

config ZMK_SPLIT
    default y

endif # SHIELD_NANO_LEFT || SHIELD_NANO_RIGHT
```

## boards/shields/nano/Kconfig.shield
```kconfig
config SHIELD_NANO_LEFT
    def_bool $(shields_list_contains,nano_left)

config SHIELD_NANO_RIGHT
    def_bool $(shields_list_contains,nano_right)
```

## boards/shields/nano1/Kconfig.defconfig
```kconfig
if SHIELD_NANO1_LEFT

config ZMK_KEYBOARD_NAME
    default "nano1"

config ZMK_SPLIT_ROLE_CENTRAL
    default y

endif # SHIELD_NANO1_LEFT

if SHIELD_NANO1_LEFT || SHIELD_NANO1_RIGHT

config ZMK_SPLIT
    default y

endif # SHIELD_NANO1_LEFT || SHIELD_NANO1_RIGHT
```

## boards/shields/nano1/Kconfig.shield
```kconfig
config SHIELD_NANO1_LEFT
    def_bool $(shields_list_contains,nano1_left)

config SHIELD_NANO1_RIGHT
    def_bool $(shields_list_contains,nano1_right)
```

## boards/shields/nano2/Kconfig.defconfig
```kconfig
if SHIELD_NANO2_LEFT

config ZMK_KEYBOARD_NAME
    default "nano2"

config ZMK_SPLIT_ROLE_CENTRAL
    default y

endif # SHIELD_NANO2_LEFT

if SHIELD_NANO2_LEFT || SHIELD_NANO2_RIGHT

config ZMK_SPLIT
    default y

endif # SHIELD_NANO2_LEFT || SHIELD_NANO2_RIGHT
```

## boards/shields/nano2/Kconfig.shield
```kconfig
config SHIELD_NANO2_LEFT
    def_bool $(shields_list_contains,nano2_left)

config SHIELD_NANO2_RIGHT
    def_bool $(shields_list_contains,nano2_right)
```

## boards/shields/steno/Kconfig.defconfig
```kconfig
if SHIELD_STENO

config ZMK_KEYBOARD_NAME
    default "steno"

endif # SHIELD_STENO
```
