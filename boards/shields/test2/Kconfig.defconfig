## boards/shields/test2/Kconfig.defconfig
```kconfig
if SHIELD_TEST2

config ZMK_KEYBOARD_NAME
    default "test2"

endif # SHIELD_TEST2
```

## boards/shields/tester/Kconfig.defconfig
```kconfig
if SHIELD_TESTER

config ZMK_KEYBOARD_NAME
    default "tester"

endif # SHIELD_TESTER
```
